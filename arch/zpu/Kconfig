## arch/zpu/Kconfig
```kconfig
config ZPU
	def_bool y
	select EXPERT
	select HAVE_GENERIC_HARDIRQS
	select GENERIC_IRQ_PROBE
        select PLATFORM_ZPU
        select HAS_DMA
        select HAS_IOMEM
        select HAVE_CLK
	help
	  ZPU support

config NO_DMA
	def_bool n
        
config GENERIC_GPIO
	def_bool y

config STACKTRACE_SUPPORT
	def_bool n

config LOCKDEP_SUPPORT
	def_bool n

config TRACE_IRQFLAGS_SUPPORT
	def_bool n

config RWSEM_GENERIC_SPINLOCK
	def_bool y

config GENERIC_CLOCKEVENTS
	def_bool y

config RWSEM_XCHGADD_ALGORITHM
	def_bool n

config ARCH_HAS_ILOG2_U32
	def_bool n

config ARCH_HAS_ILOG2_U64
	def_bool n

config GENERIC_HWEIGHT
	def_bool y

config GENERIC_CALIBRATE_DELAY
	def_bool y

config GENERIC_BUG
	def_bool y
	depends on BUG

config GENERIC_CSUM
	def_bool y

source "init/Kconfig"

source "kernel/Kconfig.freezer"

menu "System Type and features"

source "kernel/time/Kconfig"

config SUBARCH_ZCOREV3
	bool

config PLATFORM_ZPU
	bool
	select SUBARCH_ZCOREV3
	select ARCH_REQUIRE_GPIOLIB
	select GENERIC_ALLOCATOR

#
# CPU types
#

config CPU_ZPU_ZCOREV3
	bool
	select PLATFORM_ZPU

# Boards

choice
	prompt "ZPU board type"
	default BOARD_PPROS6LX9

config BOARD_PPROS6LX9
	bool "Papilio Pro with S6LX9"
	select CPU_ZPU_ZCOREV3

source "arch/zpu/boards/ppro-s6lx9/Kconfig"

endchoice 

source "arch/zpu/mach-zcorev3/Kconfig"

config LOAD_ADDRESS
	hex
	default 0x00001000 if CPU_ZPU_ZCOREV3=y

config ENTRY_ADDRESS
	hex
	default 0x00001000 if CPU_ZPU_ZCOREV3=y

config PHYS_OFFSET
	hex
	default 0x00001000 if CPU_ZPU_ZCOREV3=y

source "kernel/Kconfig.preempt"

config QUICKLIST
	def_bool y

config HAVE_ARCH_BOOTMEM
	def_bool n

config ARCH_HAVE_MEMORY_PRESENT
	def_bool n

config NEED_NODE_MEMMAP_SIZE
	def_bool n

config ARCH_FLATMEM_ENABLE
	def_bool y

config ARCH_DISCONTIGMEM_ENABLE
	def_bool n

config ARCH_SPARSEMEM_ENABLE
	def_bool n

config SCHED_OMIT_FRAME_POINTER
	def_bool y
        
source "mm/Kconfig"

# FPU emulation goes here

source "kernel/Kconfig.hz"

config CMDLINE
	string "Default kernel command line"
	default "root=/dev/mmcblk0p2"
	help
	  If you don't have a boot loader capable of passing a command line string
	  to the kernel, you may specify one here. As a minimum, you should specify
	  the memory size and the root device (e.g., mem=8M, root=/dev/nfs).

endmenu

menu "Executable file formats"
source "fs/Kconfig.binfmt"
endmenu

source "net/Kconfig"

source "drivers/Kconfig"

source "fs/Kconfig"

source "arch/zpu/Kconfig.debug"

source "security/Kconfig"

source "crypto/Kconfig"

source "lib/Kconfig"
```
